## sdkconfig.defaults
```kconfig
# EsMesh ESP32-S3 Firmware - Default Configuration

# Target chip
CONFIG_IDF_TARGET="esp32s3"

# WiFi
CONFIG_ESP32_WIFI_ENABLED=y
CONFIG_ESP32_WIFI_STATIC_RX_BUFFER_NUM=8
CONFIG_ESP32_WIFI_DYNAMIC_RX_BUFFER_NUM=16
CONFIG_WIFI_POWER_SAVE_LISTEN_INTERVAL=1

# LWIP (TCP/IP)
CONFIG_LWIP_UDP_PCB_NUM=8
CONFIG_LWIP_TCP_PCB_NUM=8
CONFIG_LWIP_TCP_MSS=1436

# mDNS
CONFIG_MDNS_ENABLE=y

# HTTP Server (httpd)
CONFIG_HTTPD_MAX_REQ_HDR_LEN=1024
CONFIG_HTTPD_MAX_URI_LEN=512
CONFIG_HTTPD_MAX_RESP_HDR_LEN=1024

# NVS (Non-Volatile Storage)
CONFIG_NVS_ENCRYPTION=n

# Memory
CONFIG_SPIRAM=y
CONFIG_SPIRAM_MODE_QUAD=y
CONFIG_SPIRAM_TYPE_AUTO=y

# Logging
CONFIG_LOG_DEFAULT_LEVEL=3
CONFIG_LOG_DEFAULT_LEVEL_INFO=y

# Partition table
CONFIG_PARTITION_TABLE_CUSTOM=y
CONFIG_PARTITION_TABLE_CUSTOM_FILENAME="partitions.csv"

# USB Serial/JTAG
CONFIG_ESP_CONSOLE_USB_SERIAL_JTAG=n
CONFIG_ESP_CONSOLE_UART=y
CONFIG_ESP_CONSOLE_UART_NUM=0
CONFIG_ESP_CONSOLE_UART_BAUDRATE=115200
```
